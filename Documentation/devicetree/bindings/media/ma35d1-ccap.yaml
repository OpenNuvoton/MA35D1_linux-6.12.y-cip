## Documentation/devicetree/bindings/media/ma35d1-ccap.yaml
```yaml
# SPDX-License-Identifier: (GPL-2.0-only OR BSD-2-Clause)
%YAML 1.2
---
$id: "http://devicetree.org/schemas/media/nuvoton,ma35d1-ccap.yaml#"
$schema: "http://devicetree.org/meta-schemas/core.yaml#"

title: Nuvoton MA35D1 Camera Capture Interface Controller (CCAP)

maintainers:
  - Your Name <your@email.com>

description: |
  The Camera Capture Interface Controller (CCAP) captures image data from
  a sensor, processes the image stream, and uses an embedded DMA engine to
  move data from internal FIFO to system memory through the AHB bus.

properties:
  compatible:
    const: nuvoton,ma35d1-ccap
    const: nuvoton,ma35d0-ccap
    const: nuvoton,ma35h0-ccap

  reg:
    maxItems: 1

  interrupts:
    maxItems: 1

  clocks:
    maxItems: 1

  clock-names:
    items:
      - const: core

  clock-frequency:
    description: Input sensor clock frequency in Hz.
    minimum: 1

  port:
    $ref: /schemas/graph.yaml#/properties/port
    description: Video input endpoint description.

required:
  - compatible
  - reg
  - interrupts

additionalProperties: false

examples:
  - |
    ccap0: ccap@40240000 {
      compatible = "nuvoton,ma35d1-ccap";
      reg = <0x0 0x40240000 0x0 0x2000>;
      interrupts = <GIC_SPI 21 IRQ_TYPE_LEVEL_HIGH>;
      clocks = <&clk ccap0_gate>;
      clock-names = "core";
      clock-frequency = <12000000>;
      status = "okay";

      port {
        #address-cells = <1>;
        #size-cells = <0>;

        ccap0_1: endpoint {
          remote-endpoint = <&nt99141_0>;
          bus-type = <5>;
          bus-width = <8>;
          hsync-active = <0>;
          vsync-active = <0>;
          pclk-sample = <1>;
        };
      };
    };

    i2c_gpio@0 {
      compatible = "i2c-gpio";
      gpios = <&gpio 3 0>,
              <&gpio 4 0>;
      i2c-gpio,sda-open-drain;
      i2c-gpio,scl-open-drain;
      i2c-gpio,delay-us = <2>;
      #address-cells = <1>;
      #size-cells = <0>;
      status = "okay";

      nt99141@2a {
        compatible = "nuvoton,nt99141";
        reg = <0x2a>;

        port {
          nt99141_0: endpoint {
            remote-endpoint = <&ccap0_1>;
          };
        };
      };
    };

    ccap1: ccap@40250000 {
      compatible = "nuvoton,ma35d1-ccap";
      reg = <0x0 0x40250000 0x0 0x2000>;
      interrupts = <GIC_SPI 22 IRQ_TYPE_LEVEL_HIGH>;
      clocks = <&clk ccap1_gate>;
      clock-names = "core";
      status = "okay";
    };
...
```

## Documentation/devicetree/bindings/serial/nuvoton,ma35d1-serial.yaml
```yaml
# SPDX-License-Identifier: (GPL-2.0-only OR BSD-2-Clause)
%YAML 1.2
---
$id: http://devicetree.org/schemas/serial/nuvoton,ma35d1-uart.yaml#
$schema: http://devicetree.org/meta-schemas/core.yaml#

title: Nuvoton MA35 Series UART Controller

description: |
  This describes the devicetree bindings for the UART controller found
  in Nuvoton MA35D1, MA35H0, and MA35D0 SoCs.

maintainers:
  - Nuvoton Technology Corporation <www.nuvoton.com>

allOf:
  - $ref: serial.yaml#

properties:
  compatible:
    enum:
      - nuvoton,ma35d1-uart
      - nuvoton,ma35h0-uart
      - nuvoton,ma35d0-uart

  reg:
    maxItems: 1

  interrupts:
    maxItems: 1

  clocks:
    maxItems: 1

  ma35d1-console:
    description: |
      Indicates that this UART instance is used as the system console.
    type: boolean

  port-number:
    description: |
      The port number assigned to this UART instance.
    $ref: /schemas/types.yaml#/definitions/uint32
    minimum: 0
    maximum: 16

  pdma-enable:
    description: |
      Indicates whether PDMA (Peripheral DMA) is enabled for this UART
      instance. 0 means disabled, 1 means enabled.
    $ref: /schemas/types.yaml#/definitions/uint32
    enum: [0, 1]

  dmas:
    minItems: 1
    maxItems: 2

  dma-names:
    minItems: 1
    maxItems: 2
    items:
      enum:
        - tx
        - rx

  wakeup-enable:
    description: |
      Enables specific wakeup sources while the UART is in low-power
      mode: <cts-wakeup fifo-threshold-wakeup fifo-timeout-wakeup>.
      Each cell is 0 (disabled) or 1 (enabled).
    $ref: /schemas/types.yaml#/definitions/uint32-array
    minItems: 3
    maxItems: 3
    items:
      enum: [0, 1]

  fifo-threshold:
    description: |
      FIFO threshold value used only when fifo-threshold-wakeup is
      enabled in wakeup-enable. Valid values are 1, 4, 8, 14, or 30
      bytes.
    $ref: /schemas/types.yaml#/definitions/uint32
    enum: [1, 4, 8, 14, 30]

required:
  - compatible
  - reg
  - interrupts
  - clocks
  - port-number

dependencies:
  dmas: [dma-names]
  dma-names: [dmas]

unevaluatedProperties: false

examples:
  - |
    #include <dt-bindings/interrupt-controller/arm-gic.h>
    serial@40700000 {
        compatible = "nuvoton,ma35d1-uart";
        reg = <0x0 0x40700000 0x0 0x10000>;
        ma35d1-console;
        interrupts = <GIC_SPI 59 IRQ_TYPE_LEVEL_HIGH>;
        clocks = <&clk UART0_GATE>;
        port-number = <0>;
        pdma-enable = <0>;
        status = "okay";
    };
  - |
    #include <dt-bindings/interrupt-controller/arm-gic.h>
    serial@40710000 {
        compatible = "nuvoton,ma35d1-uart";
        reg = <0x0 0x40710000 0x0 0x10000>;
        interrupts = <GIC_SPI 60 IRQ_TYPE_LEVEL_HIGH>;
        clocks = <&clk UART1_GATE>;
        port-number = <1>;
        dmas = <&pdma2 2>, <&pdma3 3>;
        dma-names = "tx", "rx";
        pdma-enable = <0>;
        status = "disabled";
    };
```

## Documentation/devicetree/bindings/spi/nuvoton,ma35d1-spi.yaml
```yaml
# SPDX-License-Identifier: (GPL-2.0-only OR BSD-2-Clause)
%YAML 1.2
---
$id: http://devicetree.org/schemas/spi/nuvoton,ma35d1-spi.yaml#
$schema: http://devicetree.org/meta-schemas/core.yaml#

title: Nuvoton MA35D1 SPI Controller

maintainers:
  - Chi-Wen Weng <cwweng@nuvoton.com>

description: |
  The Nuvoton MA35D1 contains four SPI controllers. Each controller supports
  full-duplex transfers, two native chip-select signals, 8- to 32-bit words,
  programmable clock polarity and phase, and optional PDMA transfers.

  This binding describes the controller operating in SPI master mode. The I2S
  function provided by the same hardware block is handled by a separate audio
  driver and binding.

allOf:
  - $ref: spi-controller.yaml#

properties:
  compatible:
    enum:
      - nuvoton,ma35d0-spi
      - nuvoton,ma35d1-spi
      - nuvoton,ma35h0-spi

  reg:
    maxItems: 1

  interrupts:
    maxItems: 1

  clocks:
    maxItems: 1

  dmas:
    minItems: 2
    maxItems: 2

  dma-names:
    items:
      - const: tx
      - const: rx

  nuvoton,pdma-reqsel-tx:
    $ref: /schemas/types.yaml#/definitions/uint32
    maximum: 255
    description:
      MA35D1 PDMA request selector used for SPI transmit requests.

  nuvoton,pdma-reqsel-rx:
    $ref: /schemas/types.yaml#/definitions/uint32
    maximum: 255
    description:
      MA35D1 PDMA request selector used for SPI receive requests.

  num-cs:
    const: 2
    default: 2

  cs-gpios: false

  spi-slave: false

required:
  - compatible
  - reg
  - interrupts
  - clocks
  - "#address-cells"
  - "#size-cells"

dependencies:
  dmas:
    - dma-names
    - nuvoton,pdma-reqsel-tx
    - nuvoton,pdma-reqsel-rx
  dma-names:
    - dmas
  nuvoton,pdma-reqsel-tx:
    - dmas
  nuvoton,pdma-reqsel-rx:
    - dmas

unevaluatedProperties: false

examples:
  - |
    #include <dt-bindings/clock/nuvoton,ma35d1-clk.h>
    #include <dt-bindings/interrupt-controller/arm-gic.h>

    spi@40600000 {
        compatible = "nuvoton,ma35d1-spi";
        reg = <0x0 0x40600000 0x0 0x10000>;
        interrupts = <GIC_SPI 89 IRQ_TYPE_LEVEL_HIGH>;
        clocks = <&clk SPI0_GATE>;

        dmas = <&pdma1 4>, <&pdma1 5>;
        dma-names = "tx", "rx";
        nuvoton,pdma-reqsel-tx = <60>;
        nuvoton,pdma-reqsel-rx = <61>;

        num-cs = <2>;
        #address-cells = <1>;
        #size-cells = <0>;
    };
...
```
